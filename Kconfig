## Kconfig
```kconfig
#
# QCA IPQ Network accelerator device configuration
#
config NSS_DEBUG_LEVEL
	int "Debug level for NSS driver"
	default 0
	---help---
	  Select between 0 and 4 (0: none, 1: assert, 2: warning, 3: info, 4: trace)
```
